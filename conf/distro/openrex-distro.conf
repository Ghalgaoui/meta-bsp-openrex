## conf/distro/openrex-distro.conf
```bitbake
require conf/distro/poky.conf

DISTRO = "openrex-distro"
DISTRO_NAME = "openrex-distro"
```

## conf/layer.conf
```bitbake
# We have a conf and classes directory, add to BBPATH
BBPATH .= ":${LAYERDIR}"

# We have recipes-* directories, add to BBFILES
BBFILES += "${LAYERDIR}/recipes-*/*/*.bb \
	${LAYERDIR}/recipes-*/*/*.bbappend"

BBFILE_COLLECTIONS += "meta-openrex"
BBFILE_PATTERN_meta-openrex = "^${LAYERDIR}/"
BBFILE_PRIORITY_meta-openrex = "8"

LAYERSERIES_COMPAT_meta-openrex = "kirkstone"
```

## conf/machine/openrex-imx6quad.conf
```bitbake
#@TYPE: Machine
#@NAME: NXP i.MX6QP/Q/DL OPENREX Smart Device
#@SOC: i.MX6QP/Q/DL
#@DESCRIPTION: Machine configuration for NXP i.MX6QP/Q/DL OPENREX Smart Device
#@MAINTAINER: Kamel Ghalgaoui <kamelghalgaoui7@gmail.com>
#

MACHINEOVERRIDES =. "mx6q:mx6dl:"

require conf/machine/include/imx-base.inc
require conf/machine/include/arm/armv7a/tune-cortexa9.inc

OPENREX_DEFAULT_KERNEL = "linux-openrex"
PREFERRED_PROVIDER_virtual/kernel ?= "${OPENREX_DEFAULT_KERNEL}"
KERNEL_DEVICETREE = "imx6q-openrex.dtb"
KERNEL_DEVICETREE:use-mainline-bsp = " \
    imx6q-openrex.dtb \
"

### u-boot-openrex settings ###
IMX_DEFAULT_BOOTLOADER ?= "u-boot-openrex"
PREFERRED_PROVIDER_u-boot ??= "${IMX_DEFAULT_BOOTLOADER}"
PREFERRED_PROVIDER_virtual/bootloader ??= "${IMX_DEFAULT_BOOTLOADER}"
SPL_BINARY:pn-u-boot-openrex = "SPL"
UBOOT_CONFIG:pn-u-boot-openrex ??= "sd"
UBOOT_SUFFIX:pn-u-boot-openrex = "img"

### u-boot-fslc settings ###
SPL_BINARY:pn-u-boot-fslc = "SPL"
UBOOT_CONFIG:pn-u-boot-fslc ??= "sd"
UBOOT_SUFFIX:pn-u-boot-fslc = "img"

### u-boot-imx settings ###
SPL_BINARY:pn-u-boot-imx = ""
UBOOT_CONFIG:pn-u-boot-imx ??= " \
    sd \
    ${@bb.utils.contains('MACHINE_FEATURES', 'optee', 'sd-optee', '', d)} \
"
UBOOT_MAKE_TARGET:pn-u-boot-imx = "u-boot.imx"
UBOOT_SUFFIX:pn-u-boot-imx = "imx"
UBOOT_MAKE_TARGET:pn-u-boot-imx-mfgtool = "u-boot.imx"
UBOOT_SUFFIX:pn-u-boot-imx-mfgtool = "imx"

UBOOT_CONFIG[sd]       = "${UBOOT_CONFIG_MACHINE_NAME}_defconfig,sdcard"
UBOOT_CONFIG[sd-optee] = "${UBOOT_CONFIG_MACHINE_NAME}_optee_defconfig,sdcard"
UBOOT_CONFIG[sata]     = "${UBOOT_CONFIG_MACHINE_NAME}_sata_defconfig"
UBOOT_CONFIG[mfgtool]  = "${UBOOT_CONFIG_MACHINE_NAME}_defconfig"

# The u-boot-imx does not provide unified functionality for DL/Q/QP SoC
# variants. Change the defconfig to the targeted SoC variant.
UBOOT_CONFIG_MACHINE_NAME                       = "mx6openrex"
UBOOT_CONFIG_MACHINE_NAME:pn-u-boot-imx         = "mx6qopenrex"
UBOOT_CONFIG_MACHINE_NAME:pn-u-boot-imx-mfgtool = "mx6qopenrex"

WKS_FILE = " \
    ${@bb.utils.contains('IMX_DEFAULT_BOOTLOADER', \
                         'u-boot-fslc', 'imx-uboot-spl-bootpart.wks.in', \
                                        'imx-uboot-bootpart.wks.in', d)}"

OPTEE_BIN_EXT = "6qsdb"

SERIAL_CONSOLES = "115200;ttymxc0"

MACHINE_FIRMWARE:append:mx6 = " linux-firmware-ath6k"

MACHINE_FEATURES += " pci wifi bluetooth nxp8987-sdio"
```
